#include "dabase.dtsi"

&kscan0 {
    col-gpios
        = <&gpio0 10 GPIO_ACTIVE_HIGH>
        , <&gpio0 09 GPIO_ACTIVE_HIGH>
        , <&gpio0 22 GPIO_ACTIVE_HIGH>
        , <&gpio0 24 GPIO_ACTIVE_HIGH>
        , <&gpio1 00 GPIO_ACTIVE_HIGH>
        , <&gpio0 11 GPIO_ACTIVE_HIGH>
        , <&gpio1 04 GPIO_ACTIVE_HIGH>
        , <&gpio1 06 GPIO_ACTIVE_HIGH>
        ;
};

&left_encoder {
    status = "okay";
};
