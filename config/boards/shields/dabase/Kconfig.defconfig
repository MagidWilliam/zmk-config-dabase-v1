## config/boards/shields/dabase/Kconfig.defconfig
```kconfig
if SHIELD_DABASE_LEFT

config ZMK_KEYBOARD_NAME
    default "Dabase-L"

config ZMK_SPLIT_BLE_ROLE_CENTRAL
    default y

endif

if SHIELD_DABASE_RIGHT

config ZMK_KEYBOARD_NAME
    default "Dabase-R"

endif

if SHIELD_DABASE_LEFT || SHIELD_DABASE_RIGHT

config ZMK_SPLIT
    default y
endif
```

## config/boards/shields/dabase/Kconfig.shield
```kconfig
config DABASE_LEFT
    def_bool $(shields_list_contains,dabase_left)

config DABASE_RIGHT
    def_bool $(shields_list_contains,dabase_right)
```
